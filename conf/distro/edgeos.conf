## conf/distro/edgeos.conf
```bitbake
require conf/distro/poky.conf
require systemd.conf

DISTRO = "edgeos"
DISTROOVERRIDES = "poky"

DISTRO_NAME = "edgeOS Linux platform"
DISTRO_VERSION = "0.1.0"
# DISTRO_CODENAME = "..."

SDK_VENDOR = "-edgeossdk"
SDK_VERSION = "${@d.getVar('DISTRO_VERSION')}"
SDK_NAME = "${DISTRO}-${TCLIBC}-${SDKMACHINE}-${IMAGE_BASENAME}-${TUNE_PKGARCH}-${MACHINE}"
SDKPATHINSTALL = "/opt/${DISTRO}/${SDK_VERSION}"

# MAINTAINER = "name <email>"

# remove distro unnecessary feature(s)
DISTRO_FEATURES:remove = " \
    x11 \
    wayland \
    opengl \
    opengles \
    egl \
    sysvinit \
    ptest \
    3g \
    "

# Set the '/var/log' location, i.e. either on persistent storage
# of on volatile filesystem
#
# [Note]
# On newer Yocto versions, the 'VOLATILE_LOG_DIR' becomes deprecated
# and the replacement is via the 'FILESYSTEM_PERMS_TABLES' variable.
# VOLATILE_LOG_DIR = "${@'no' if d.getVar('EDGEOS_PERSIST_JOURNAL_LOGS') == '1' else 'yes'}"

PACKAGE_CLASSES ?= "package_rpm"

SANITY_TESTED_DISTROS ?= " \
    ubuntu-20.04 \n\
    ubuntu-22.04 \n\
    ubuntu-24.04 \n\
    "

# require conf/distro/include/no-static-libs.inc
# require conf/distro/include/yocto-uninative.inc
# require conf/distro/include/security_flags.inc

INHERIT += "uninative"

USE_REDUNDANT_FLASH_LAYOUT_DEFAULT ?= "1"

# INHERIT += "tegra-support-sanity"
# ESDK_CLASS_INHERIT_DISABLE:append = " tegra-support-sanity"

BB_SIGNATURE_HANDLER ?= "OEEquivHash"
BB_HASHSERVE ??= "auto"
```

## conf/distro/include/flash-image-sizes.inc
```bitbake
# Flash Image Size Configurations for EdgeOS
#
# This file defines custom partition sizes for NVMe flash images.
# The image size is controlled by TEGRA_EXTERNAL_DEVICE_SECTORS,
# and APP partition sizes are controlled by ROOTFSPART_SIZE_DEFAULT.
#
# Usage: Set EDGEOS_FLASH_IMAGE_SIZE in local.conf or distro config
#        Values: "4GB", "8GB", "16GB", "32GB", "64GB" (default: "8GB")

EDGEOS_FLASH_IMAGE_SIZE ??= "8GB"

# Total sectors for different image sizes (sector size = 512 bytes)
# Formula: (SIZE_IN_GB * 1000 * 1000 * 1000) / 512
TEGRA_EXTERNAL_DEVICE_SECTORS:4GB = "7812500"
TEGRA_EXTERNAL_DEVICE_SECTORS:8GB = "15625000"
TEGRA_EXTERNAL_DEVICE_SECTORS:16GB = "31250000"
TEGRA_EXTERNAL_DEVICE_SECTORS:32GB = "62500000"
TEGRA_EXTERNAL_DEVICE_SECTORS:64GB = "125000000"

# Override based on EDGEOS_FLASH_IMAGE_SIZE
TEGRA_EXTERNAL_DEVICE_SECTORS = "${TEGRA_EXTERNAL_DEVICE_SECTORS:${EDGEOS_FLASH_IMAGE_SIZE}}"

# APP partition sizes (bytes) for different image sizes
# These values account for:
# - Fixed partitions (boot, recovery, esp, UDA, reserved): ~1.5GB
# - 100MB safety buffer for GPT overhead
# - Remaining space split between APP and APP_b partitions
#
# Formula per APP partition: ((total_bytes - fixed_bytes - buffer) / 2)

# Mender storage size in MB for different image sizes
# Mender uses this to calculate APP partition sizes automatically
# Note: These values are adjusted to account for Tegra fixed partitions (~1.5GB)
# and include safety margin for GPT overhead
#
# Formula: (total_size_gb - tegra_fixed_partitions_gb - safety_margin_gb) * 1000
#   4GB:  (4.0 - 0.7 - 0.1) * 1000 = 3200 MB
#   8GB:  (8.0 - 1.5 - 0.1) * 1000 = 6400 MB
#  16GB: (16.0 - 3.1 - 0.1) * 1000 = 12800 MB
#  32GB: (32.0 - 6.2 - 0.1) * 1000 = 25700 MB
#  64GB: (64.0 - 12.5 - 0.5) * 1000 = 51000 MB
MENDER_STORAGE_TOTAL_SIZE_MB = "${@{'4GB': '3200', '8GB': '6400', '16GB': '12800', '32GB': '25700', '64GB': '51000'}.get(d.getVar('EDGEOS_FLASH_IMAGE_SIZE'), '6400')}"
```

## conf/distro/include/mender-secrets.inc
```bitbake
# DO NOT COMMIT this file to version control!

# Example for Hosted Mender; swap for your on-prem URL/token.
MENDER_SERVER_URL = "https://hosted.mender.io"
MENDER_TENANT_TOKEN = "YOUR-TENANT-TOKEN"
```

## conf/distro/include/mender.inc
```bitbake
# Image outputs: disk + OTA artifact
# IMAGE_FSTYPES += "uefiimg mender ext4"

INHERIT += "mender-full"

# tegra
# these two classes only work as intended when being inherited in the
# OE4t setup-env.sh style environment, as they modify bblayers.conf
# and expect additional information on the host.
INHERIT:remove = "tegra-support-sanity distro_layer_buildinfo"
INHERIT += "tegra-mender-setup"
```

## conf/distro/systemd.conf
```bitbake
# enable systemd (instead of sysvinit)
# (use systemd as PID 1)
DISTRO_FEATURES:append = " systemd usrmerge"
DISTRO_FEATURES:remove = " sysvinit"

# prevent the old sysvinit feature from being backfilled
DISTRO_FEATURES_BACKFILL_CONSIDERED += " sysvinit"

VIRTUAL-RUNTIME_init_manager = "systemd"
INIT_MANAGER = "systemd"

# provide compatibility for packages that still ship SysV scripts
# (optional)
VIRTUAL-RUNTIME_initscripts = "systemd-compat-units"
# VIRTUAL-RUNTIME_syslog = ""
# VIRTUAL-RUNTIME_base-utils-syslog = ""

# using '/home/root' as root user's home directory is not fully supported by
# systemd as the code hardcodes '/root'
ROOT_HOME = "/root"
```

## conf/layer.conf
```bitbake
# Make the layer visible to bitbake
BBPATH:prepend := "${LAYERDIR}:"

# Where to find recipes in this layer
BBFILES += " \
    ${LAYERDIR}/recipes-*/*/*.bb \
    ${LAYERDIR}/recipes-*/*/*.bbappend \
    "

# Register this layer
BBFILE_COLLECTIONS += "edgeos"
BBFILE_PATTERN_edgeos := "^${LAYERDIR}/"
BBFILE_PRIORITY_edgeos = "50"

# Layer compatibility (set to your Yocto release)
# Pick ONE or more that actually match your base (poky/meta, meta-tegra, etc.)
LAYERSERIES_COMPAT_edgeos = "scarthgap"
LAYERVERSION_edgeos = "1"

# Dependencies on other layers (at minimum you depend on 'core')
LAYERDEPENDS_edgeos = "core"

# This is used by the tegra-distro-sanity bbclass
# to identify the distro layer directory during
# bblayers checks.
TD_DISTRO_LAYERDIR = "${LAYERDIR}"
```

## conf/machine/jetson-orin-nano-devkit-nvme-edgeos.conf
```bitbake
# jetson-orin-nano-devkit-nvme-edgeos.conf
# NVMe boot configuration for Jetson Orin Nano DevKit

MACHINEOVERRIDES =. "jetson-orin-nano-devkit:"

# include upstream base if available
require conf/machine/jetson-orin-nano-devkit-nvme.conf 

# AB upgrades & bootloader choices (board-specific)
UBOOT_EXTLINUX = "1"
USE_REDUNDANT_FLASH_LAYOUT_DEFAULT = "1"

MENDER_FEATURES_DISABLE:append = " mender-uboot"
MENDER_EFI_LOADER = ""

# NVMe Storage geometry (board-specific)
MENDER_STORAGE_TOTAL_SIZE_MB = "30720"
MENDER_STORAGE_DEVICE_BASE = "/dev/nvme0n1p"
MENDER_BOOT_PART = "${MENDER_STORAGE_DEVICE_BASE}11"
MENDER_DATA_PART = "${MENDER_STORAGE_DEVICE_BASE}15"
MENDER_ROOTFS_PART_A = "${MENDER_STORAGE_DEVICE_BASE}1"
MENDER_ROOTFS_PART_B = "${MENDER_STORAGE_DEVICE_BASE}2"
MENDER_DATA_PART_SIZE_MB = "400"

# NVMe boot device configuration
TNSPEC_BOOTDEV = "nvme0n1p1"

# Use NVMe partition layout
PARTITION_LAYOUT_TEMPLATE_DEFAULT = "flash_t234_qspi.xml"
PARTITION_LAYOUT_TEMPLATE_DEFAULT_SUPPORTS_REDUNDANT = "1"
PARTITION_LAYOUT_EXTERNAL_DEFAULT = "flash_l4t_t234_nvme.xml"

# Jetson image formats that are machine/BSP oriented:
IMAGE_FSTYPES:tegra = "tegraflash mender dataimg"
IMAGE_FSTYPES:pn-tegra-minimal-initramfs:tegra = "${INITRAMFS_FSTYPES}"
IMAGE_FSTYPES:pn-tegra-initrd-flash-initramfs:tegra = "${TEGRA_INITRD_FLASH_INITRAMFS_FSTYPES}"

# If you really need it, board param (but consider removing if unused):
EMMC_SIZE = "0"
```
